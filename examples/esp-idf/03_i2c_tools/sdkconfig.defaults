## examples/esp-idf/03_i2c_tools/sdkconfig.defaults
```kconfig
CONFIG_IDF_TARGET="esp32p4"
CONFIG_ESP32P4_REV_MIN_300=y
# CONFIG_ESP32P4_SELECTS_REV_LESS_V3 is not set
# Reduce bootloader log verbosity
CONFIG_BOOTLOADER_LOG_LEVEL_ERROR=y
CONFIG_BOOTLOADER_LOG_LEVEL=1

# Increase main task stack size
CONFIG_ESP_MAIN_TASK_STACK_SIZE=7168

# Enable filesystem
CONFIG_PARTITION_TABLE_CUSTOM=y
CONFIG_PARTITION_TABLE_CUSTOM_FILENAME="partitions_example.csv"
CONFIG_PARTITION_TABLE_FILENAME="partitions_example.csv"

# Enable FreeRTOS stats formatting functions, needed for 'tasks' command
CONFIG_FREERTOS_USE_TRACE_FACILITY=y
CONFIG_FREERTOS_USE_STATS_FORMATTING_FUNCTIONS=y

CONFIG_ESPTOOLPY_FLASHSIZE_32MB=y
```

## examples/esp-idf/07_Displaycolorbar/sdkconfig.defaults
```kconfig
CONFIG_IDF_TARGET="esp32p4"
# CONFIG_ESP32P4_SELECTS_REV_LESS_V3 is not set
CONFIG_ESP32P4_REV_MIN_300=y
CONFIG_BOOTLOADER_LOG_LEVEL_ERROR=y
CONFIG_BOOTLOADER_LOG_LEVEL=1
CONFIG_ESP_TASK_WDT_EN=n
CONFIG_FREERTOS_HZ=1000
CONFIG_FREERTOS_TIMER_TASK_STACK_DEPTH=4096
```

## examples/esp-idf/07_Displaycolorbar/sdkconfig.defaults.esp32p4
```kconfig
CONFIG_IDF_TARGET="esp32p4"
CONFIG_ESPTOOLPY_FLASHSIZE_32MB=y
CONFIG_COMPILER_OPTIMIZATION_PERF=y
CONFIG_SPIRAM=y
CONFIG_SPIRAM_SPEED_200M=y
CONFIG_IDF_EXPERIMENTAL_FEATURES=y
```

## firmware/brookesia/main/Kconfig.projbuild
```kconfig
menu "Phone UI"

    choice PHONE_STYLESHEET
        prompt "Phone stylesheet"
        default PHONE_STYLESHEET_10_INCH
        help
            Select the landscape stylesheet for the panel. The
            sdkconfig.defaults.lcd-* files select this for each panel.

        config PHONE_STYLESHEET_7_INCH
            bool "7 inch"

        config PHONE_STYLESHEET_8_INCH
            bool "8 inch"

        config PHONE_STYLESHEET_10_INCH
            bool "10.1 inch"
    endchoice

endmenu
```

## firmware/brookesia/sdkconfig.defaults
```kconfig
# ---------------------------------------------------------------------------
# Target and compiler
# ---------------------------------------------------------------------------
CONFIG_IDF_TARGET="esp32p4"
CONFIG_IDF_EXPERIMENTAL_FEATURES=y
CONFIG_COMPILER_OPTIMIZATION_PERF=y
CONFIG_COMPILER_DISABLE_DEFAULT_ERRORS=y

# ---------------------------------------------------------------------------
# Chip revision (default profile: ESP32-P4 Rev3.x)
# ---------------------------------------------------------------------------
# Rev1.x builds append sdkconfig.defaults.rev1_3 after this file.
# CONFIG_ESP32P4_SELECTS_REV_LESS_V3 is not set
CONFIG_ESP32P4_REV_MIN_300=y
CONFIG_BOOTLOADER_LOG_LEVEL_ERROR=y
CONFIG_BOOTLOADER_LOG_LEVEL=1

# ---------------------------------------------------------------------------
# Flash and partitions
# ---------------------------------------------------------------------------
CONFIG_ESPTOOLPY_FLASHMODE_QIO=y
CONFIG_ESPTOOLPY_FLASHSIZE_32MB=y
CONFIG_PARTITION_TABLE_CUSTOM=y
CONFIG_PARTITION_TABLE_OFFSET=0x9000

# ---------------------------------------------------------------------------
# PSRAM
# ---------------------------------------------------------------------------
# Run code/rodata from PSRAM and keep internal RAM for DMA and the GUI.
CONFIG_SPIRAM=y
CONFIG_SPIRAM_MODE_HEX=y
CONFIG_SPIRAM_FETCH_INSTRUCTIONS=y
CONFIG_SPIRAM_RODATA=y
CONFIG_SPIRAM_XIP_FROM_PSRAM=y
CONFIG_SPIRAM_MALLOC_ALWAYSINTERNAL=0
CONFIG_SPIRAM_MALLOC_RESERVE_INTERNAL=4096
CONFIG_SPIRAM_MEMTEST=y
CONFIG_SPIRAM_SPEED_250M=y

# ---------------------------------------------------------------------------
# Console
# ---------------------------------------------------------------------------
CONFIG_ESP_CONSOLE_UART_CUSTOM=y
CONFIG_ESP_CONSOLE_UART_BAUDRATE=2000000

# ---------------------------------------------------------------------------
# System and FreeRTOS
# ---------------------------------------------------------------------------
CONFIG_ESP_SYSTEM_EVENT_TASK_STACK_SIZE=4096
CONFIG_ESP_MAIN_TASK_STACK_SIZE=10240
CONFIG_FREERTOS_HZ=1000
CONFIG_FREERTOS_TASK_CREATE_ALLOW_EXT_MEM=y
CONFIG_VFS_MAX_COUNT=20

# ---------------------------------------------------------------------------
# Wi-Fi (ESP-Hosted)
# ---------------------------------------------------------------------------
# ESP32-P4 uses the on-board ESP32-C6 through ESP-Hosted over SDIO.
# Transport pins and reset defaults come from the matching esp_hosted 1.4.x P4 profile.
CONFIG_SLAVE_IDF_TARGET_ESP32C6=y
CONFIG_WIFI_RMT_STATIC_RX_BUFFER_NUM=16
CONFIG_WIFI_RMT_DYNAMIC_RX_BUFFER_NUM=64
CONFIG_WIFI_RMT_DYNAMIC_TX_BUFFER_NUM=64
CONFIG_WIFI_RMT_AMPDU_TX_ENABLED=y
CONFIG_WIFI_RMT_TX_BA_WIN=32
CONFIG_WIFI_RMT_AMPDU_RX_ENABLED=y
CONFIG_WIFI_RMT_RX_BA_WIN=32

# ---------------------------------------------------------------------------
# lwIP
# ---------------------------------------------------------------------------
CONFIG_LWIP_TCP_SND_BUF_DEFAULT=65534
CONFIG_LWIP_TCP_WND_DEFAULT=65534
CONFIG_LWIP_TCP_RECVMBOX_SIZE=64
CONFIG_LWIP_UDP_RECVMBOX_SIZE=64
CONFIG_LWIP_TCPIP_RECVMBOX_SIZE=64
CONFIG_LWIP_TCP_SACK_OUT=y

# ---------------------------------------------------------------------------
# LVGL
# ---------------------------------------------------------------------------
# LVGL task/tick are owned by esp_lvgl_adapter; VideoPlayer uses adapter Dummy Draw.
CONFIG_LV_OS_FREERTOS=y
CONFIG_LV_USE_CLIB_MALLOC=y
CONFIG_LV_USE_CLIB_STRING=y
CONFIG_LV_USE_CLIB_SPRINTF=y
CONFIG_LV_DEF_REFR_PERIOD=15
CONFIG_LV_OBJ_STYLE_CACHE=y
CONFIG_LV_DRAW_SW_DRAW_UNIT_CNT=2
CONFIG_LV_USE_LOG=y
CONFIG_LV_LOG_PRINTF=y
CONFIG_LV_USE_SNAPSHOT=y
CONFIG_LV_BUILD_EXAMPLES=n

# xiaozhi-fonts renders emoji glyphs through LVGL's image-font backend.
CONFIG_LV_USE_IMGFONT=y

# brookesia_core resolves fonts by pixel size at runtime, so keep the full
# Montserrat range it can request.
CONFIG_LV_FONT_MONTSERRAT_8=y
CONFIG_LV_FONT_MONTSERRAT_10=y
CONFIG_LV_FONT_MONTSERRAT_12=y
CONFIG_LV_FONT_MONTSERRAT_16=y
CONFIG_LV_FONT_MONTSERRAT_18=y
CONFIG_LV_FONT_MONTSERRAT_20=y
CONFIG_LV_FONT_MONTSERRAT_22=y
CONFIG_LV_FONT_MONTSERRAT_24=y
CONFIG_LV_FONT_MONTSERRAT_26=y
CONFIG_LV_FONT_MONTSERRAT_28=y
CONFIG_LV_FONT_MONTSERRAT_30=y
CONFIG_LV_FONT_MONTSERRAT_32=y
CONFIG_LV_FONT_MONTSERRAT_34=y
CONFIG_LV_FONT_MONTSERRAT_36=y
CONFIG_LV_FONT_MONTSERRAT_38=y
CONFIG_LV_FONT_MONTSERRAT_40=y
CONFIG_LV_FONT_MONTSERRAT_42=y
CONFIG_LV_FONT_MONTSERRAT_44=y
CONFIG_LV_FONT_FMT_TXT_LARGE=y
CONFIG_LV_USE_FONT_COMPRESSED=y

# ---------------------------------------------------------------------------
# Camera (OV5647) and ISP/IPA
# ---------------------------------------------------------------------------
CONFIG_CAMERA_OV5647=y
CONFIG_CAMERA_OV5647_MIPI_RAW8_800X1280_50FPS=y
CONFIG_CAMERA_OV5647_MIPI_DEFAULT_FMT_RAW8_800X1280_50FPS=y
CONFIG_ESP_VIDEO_ENABLE_ISP_PIPELINE_CONTROLLER=y
CONFIG_CAMERA_OV5647_CSI_LINESYNC_ENABLE=y
# CONFIG_CAMERA_OV5647_DEFAULT_IPA_JSON_CONFIGURATION_FILE is not set
CONFIG_CAMERA_OV5647_CUSTOMIZED_IPA_JSON_CONFIGURATION_FILE=y
CONFIG_CAMERA_OV5647_CUSTOMIZED_IPA_JSON_CONFIGURATION_FILE_PATH="components/Camera/config/ov5647_ipa.json"
CONFIG_ESP_IPA_AWB_ALGORITHM=y

# ---------------------------------------------------------------------------
# ESP-Brookesia
# ---------------------------------------------------------------------------
# Core: phone system and the StorageNVS service.
CONFIG_ESP_BROOKESIA_ENABLE_AI_FRAMEWORK=n
CONFIG_ESP_BROOKESIA_GUI_ENABLE_ANIM_PLAYER=n
CONFIG_ESP_BROOKESIA_ENABLE_SERVICES=y
CONFIG_ESP_BROOKESIA_SERVICES_ENABLE_STORAGE_NVS=y
CONFIG_ESP_BROOKESIA_SYSTEMS_ENABLE_SPEAKER=n
CONFIG_BOOST_MATH_ENABLED=n
CONFIG_BOOST_SERIALIZATION_ENABLED=n
CONFIG_BOOST_THREAD_ENABLED=y

# ---------------------------------------------------------------------------
# Xiaozhi
# ---------------------------------------------------------------------------
# Xiaozhi wake word: "Ni Hao Xiao Zhi" (WakeNet 9s and WakeNet 9).
CONFIG_SR_WN_WN9S_NIHAOXIAOZHI=y
CONFIG_SR_WN_WN9_NIHAOXIAOZHI_TTS=y

# Xiaozhi-owned status and activation fallback text. Server text is unchanged.
CONFIG_XIAOZHI_APP_UI_LANGUAGE_ENGLISH=y
CONFIG_XIAOZHI_APP_TRANSPORT_AUTO=y

# Keep synchronous service requests within the app lifecycle wait window.
CONFIG_XIAOZHI_INFO_TIMEOUT_MS=8000
CONFIG_XIAOZHI_SYNC_SYSTEM_TIME_FROM_SERVER=n
```

## firmware/brookesia/sdkconfig.defaults.rev3_x
```kconfig
# ESP32-P4 rev 3.x profile.
CONFIG_ESP32P4_REV_MIN_300=y
# CONFIG_ESP32P4_SELECTS_REV_LESS_V3 is not set
CONFIG_SPIRAM_SPEED_250M=y
CONFIG_SPIRAM_SPEED=250
CONFIG_BOOTLOADER_LOG_LEVEL_ERROR=y
CONFIG_BOOTLOADER_LOG_LEVEL=1
```
